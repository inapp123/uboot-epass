## configs/liulianpi_f1c100s_norflash_defconfig
```kconfig
CONFIG_ARM=y
CONFIG_ARCH_SUNXI=y
CONFIG_TEXT_BASE=0x80C00000
CONFIG_DEFAULT_DEVICE_TREE="allwinner/suniv-f1c100s-liulianpi"
CONFIG_SYS_LOAD_ADDR=0x80500000
CONFIG_SPL=y
CONFIG_MACH_SUNIV=y
CONFIG_DRAM_CLK=156
CONFIG_DRAM_ZQ=0
CONFIG_VIDEO_LCD_MODE="x:480,y:272,depth:18,pclk_khz:10000,le:42,ri:8,up:11,lo:4,hs:1,vs:1,sync:3,vmode:0"
CONFIG_SPL_SPI_SUNXI=y
CONFIG_STACK_SIZE=0x500000
CONFIG_USE_BOOTARGS=y
CONFIG_BOOTARGS="console=ttyS0,115200 panic=5 rootwait mtdparts=spi0.0:1M(uboot)ro,64k(dtb)ro,4M(kernel)ro,-(rootfs) root=/dev/mtdblock3 earlyprintk rw rootfstype=jffs2"
CONFIG_BOOTCOMMAND="sf probe 0 50000000; sf read 0x80C00000 0x100000 0x4000; sf read 0x80008000 0x110000 0x4A0000; bootz 0x80008000 - 0x80C00000"
# CONFIG_CONSOLE_MUX is not set
# CONFIG_CMD_CLS is not set
CONFIG_ENV_IS_NOWHERE=y
# CONFIG_ENV_IS_IN_FAT is not set
CONFIG_MTD=y
CONFIG_SPI_FLASH_WINBOND=y
CONFIG_SPI_FLASH_XTX=y
CONFIG_SPI=y
CONFIG_BMP=y
```
